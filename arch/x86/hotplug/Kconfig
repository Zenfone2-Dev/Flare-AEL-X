## arch/x86/hotplug/Kconfig
```kconfig
config ASMP
	bool "Multi-core automatic hotplug support"
	depends on SMP && HOTPLUG_CPU
	default n
	help
	  Automatically hotplugs the multiple cpu cores on and off
	  based on cpu load and suspend state

config ALUCARD_HOTPLUG
	bool "Enable alucard-hotplug cpu hotplug driver"
	default y
	help
	  Alucard-hotplug cpu hotplug driver

config MSM_HOTPLUG
	bool "MSM hotplug driver"
	depends on HOTPLUG_CPU
	default n
	help
	  The MSM hotplug driver controls on-/offlining of additional cores based
	  on current cpu load.

config INTELLI_PLUG
        bool "Enable intelli-plug cpu hotplug driver"
        default n
        help
          Generic Intelli-plug cpu hotplug driver for ARM SOCs

config MPDECISION
	bool "MSM MPDECISION driver"
	depends on HOTPLUG_CPU
	default n
	help
	  The MSM hotplug driver controls on-/offlining of additional cores based
	  on current cpu load.
```

## arch/x86/kernel/hotplug/Kconfig
```kconfig
config ASMP
	bool "Multi-core automatic hotplug support"
	depends on SMP && HOTPLUG_CPU
	default n
	help
	  Automatically hotplugs the multiple cpu cores on and off
	  based on cpu load and suspend state

config MSM_HOTPLUG
	bool "MSM hotplug driver"
	depends on HOTPLUG_CPU
	default n
	help
	  The MSM hotplug driver controls on-/offlining of additional cores based
	  on current cpu load.

config MPDECISION
	bool "MSM MPDECISION driver"
	depends on HOTPLUG_CPU
	default n
	help
	  The MSM hotplug driver controls on-/offlining of additional cores based
	  on current cpu load.
```
